## CMakeLists.txt
```
# SPDX-License-Identifier: BSL-1.0

cmake_minimum_required(VERSION 3.30)

find_package(Zephyr HINTS $ENV{ZEPHYR_BASE})

project(001-settings-json
        VERSION 1.0.0
        LANGUAGES C ASM
        DESCRIPTION "VS Code settings for Zephyr"
        HOMEPAGE_URL "https://github.com/juanjin-dev/learning-zephyr")

add_subdirectory(src)
```

## prj.conf
```kconfig
# SPDX-License-Identifier: BSL-1.0

CONFIG_LED=y
CONFIG_INPUT=y
```

## boards/blackpill_f411ce.overlay
```dts
/**
 * SPDX-License-Identifier: BSL-1.0
 */
```

## src/main.c
```c
/**
 * SPDX-License-Identifier: BSL-1.0
 */

#include <zephyr/kernel.h>
#include <zephyr/drivers/led.h>
#include <zephyr/input/input.h>

static void input_callback(struct input_event *evt, void *user_data)
{
    UNUSED(user_data);
    
    switch (evt->type) {
        case INPUT_EV_KEY: {
            switch (evt->code) {
                case INPUT_KEY_0: {
                    const struct led_dt_spec led =
                        LED_DT_SPEC_GET(DT_ALIAS(led0));
                    if (evt->value) {
                        led_on_dt(&led);
                    } else {
                        led_off_dt(&led);
                    }
                    break;
                }
                default: {
                    printk("Unknown key code: %u\n", evt->code);
                    break;
                }
            }
            break;
        }
        default: {
            printk("Unknown key type: %u\n", evt->type);
            break;
        }
    }
}

INPUT_CALLBACK_DEFINE(NULL, input_callback, NULL);

int main(void) {
    printk("Hell Zephyr!: %s(%s, %s), %lldms\r\n",
        CONFIG_BOARD, CONFIG_ARCH, CONFIG_SOC, k_uptime_get());

    return 0;
}
```
